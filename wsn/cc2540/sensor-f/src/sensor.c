/*********************************************************************************************
* 文件：sensor.c
* 作者：Xuzhy 2018.5.16
* 说明：节点工程驱动模版
*       节点具备三个属性：定时上报燃气浓度值；实时监测燃气超标报警；远程控制燃气阀门开关
*       变量A0表示燃气浓度值，A1表示报警状态值
*       V0表示燃气浓度值主动上报时间间隔
*       D0(Bit0/Bit1)分别表示A0/A1主动上报使能
*       D1表示燃气阀门继电器开关状态，OD1/CD1进行控制
*       默认值：A0=0,A1=0,V0=30,D0=3
* 修改：
* 注释：
*********************************************************************************************/

/*********************************************************************************************
* 头文件
*********************************************************************************************/
#include <stdio.h>
#include <stdlib.h>
#include <string.h>
#include "hal_types.h"
#include "ioCC2541.h"
#include <osal.h>
#include "osal_nv.h"
#include "hal_led.h"
#include "hal_adc.h"
#include "hal_uart.h"
#include "sensor.h"
#include "zxbee.h"
#include "zxbee-inf.h"
#include "mpu9250.h"
#include "gps.h"

/*********************************************************************************************
* 宏定义
*********************************************************************************************/


/*********************************************************************************************
* 全局变量
*********************************************************************************************/
unsigned int V0 = 30;
unsigned int A0 = 0;            //gps状态 0：不在线，1在线
static char A1[32];             //记录经纬度
unsigned int A2 = 0;            //记录总步数 

static char A3[32];				//加速度传感器x，y，z数据，格式：x&y&z
static char A4[32];				//陀螺仪传感器x，y，z数据，格式：x&y&z
static char A5[32];				//地磁仪传感器x，y，z数据，格式：x&y&z

/*********************************************************************************************
* 名称：updateV0()
* 功能：更新V0的值
* 参数：*val -- 待更新的变量
* 返回：
* 修改：
* 注释：
*********************************************************************************************/
void updateV0(char *val)
{
  //将字符串变量val解析转换为整型变量赋值
  V0 = atoi(val);                                 // 获取数据上报时间更改值
}
/*********************************************************************************************
* 名称：updateA0()
* 功能：
* 参数：
* 返回：
* 修改：
* 注释：
*********************************************************************************************/
void updateA0(void)
{
  char lat[16], lng[16];
  A0 = gps_get(lat, lng);       //获取GPS信息
}
/*********************************************************************************************
* 名称：updateA1()
* 功能：
* 参数：
* 返回：
* 修改：
* 注释：
*********************************************************************************************/
void updateA1(void)
{
  char lat[16], lng[16];
  unsigned char gps_status = 0;
  gps_status = gps_get(lat, lng);        //获取GPS信息
  if(gps_status == 1){
    sprintf(A1, "%s&%s", lat,lng);
  } else{
    sprintf(A1, "%s&%s", "0","0");
  }
}
/*********************************************************************************************
* 名称：updateA2()
* 功能：
* 参数：
* 返回：
* 修改：
* 注释：
*********************************************************************************************/
void updateA2(void)
{

}
/*********************************************************************************************
* 名称：updateA2()
* 功能：
* 参数：
* 返回：
* 修改：
* 注释：
*********************************************************************************************/
void updateA3(void)
{
  float x, y, z;
  mpu9250_accel(&x, &y, &z);
  sprintf(A3, "%.1f&%.1f&%.1f", x, y, z);
}
/*********************************************************************************************
* 名称：updateA4()
* 功能：
* 参数：
* 返回：
* 修改：
* 注释：
*********************************************************************************************/
void updateA4(void)
{
   int16_t x, y, z;
  mpu9250_gyro(&x, &y, &z);
  sprintf(A4, "%d&%d&%d", x, y, z);
}
/*********************************************************************************************
* 名称：updateA5()
* 功能：
* 参数：
* 返回：
* 修改：
* 注释：
*********************************************************************************************/
void updateA5(void)
{
   int16_t x, y, z;
  mpu9250_mga(&x, &y, &z);
  sprintf(A5, "%d&%d&%d", x, y, z);
}
/*********************************************************************************************
* 名称：sensorInit()
* 功能：传感器硬件初始化
* 参数：无
* 返回：无
* 修改：
* 注释：
*********************************************************************************************/
void sensorInit(void)
{
  
  gps_init();
  
  mpu9250_init();

  // 启动定时器，触发传感器上报数据事件：MY_REPORT_EVT
  osal_start_timerEx(simpleBLEPeripheral_TaskID, MY_REPORT_EVT, (uint16)((osal_rand()%10) * 1000));
  // 启动定时器，触发传感器监测事件：MY_CHECK_EVT
  osal_start_timerEx(simpleBLEPeripheral_TaskID, MY_CHECK_EVT, 100);
}
/*********************************************************************************************
* 名称：sensorLinkOn()
* 功能：传感器节点入网成功调用函数
* 参数：无
* 返回：无
* 修改：
* 注释：
*********************************************************************************************/
void sensorLinkOn(void)
{
  sensorUpdate();
}
/*********************************************************************************************
* 名称：sensorUpdate()
* 功能：处理主动上报的数据
* 参数：无
* 返回：无
* 修改：
* 注释：
*********************************************************************************************/
void sensorUpdate(void)
{ 
  char buf[64];

  updateA0();
  updateA1();
  updateA2();
  
  updateA3();
  updateA4();
  updateA5();
  
  ZXBeeBegin();
  
  sprintf(buf, "%u", A0);
  
  ZXBeeAdd("A0", buf);
  ZXBeeAdd("A1", A1);
  sprintf(buf, "%u", A2);
  ZXBeeAdd("A2", buf);
  
  ZXBeeAdd("A3", A3);
  ZXBeeAdd("A4", A4);
  ZXBeeAdd("A5", A5);
  
  char *p = ZXBeeEnd();
  if (p != NULL) {
    ZXBeeInfSend(p, strlen(p));
  }
}
/*********************************************************************************************
* 名称：sensorCheck()
* 功能：传感器监测
* 参数：无
* 返回：无
* 修改：
* 注释：
*********************************************************************************************/
void sensorCheck(void)
{
  
}
/*********************************************************************************************
* 名称：sensorControl()
* 功能：传感器控制
* 参数：cmd - 控制命令
* 返回：无
* 修改：
* 注释：
*********************************************************************************************/
void sensorControl(uint8 cmd)
{

}
/*********************************************************************************************
* 名称：ZXBeeUserProcess()
* 功能：解析收到的控制命令
* 参数：*ptag -- 控制命令名称
*       *pval -- 控制命令参数
* 返回：ret -- pout字符串长度
* 修改：
* 注释：
*********************************************************************************************/
int ZXBeeUserProcess(char *ptag, char *pval)
{ 
  char buf[64];
  
  if (strcmp(ptag, "A0") == 0) {
    if (pval[0] == '?') {
      sprintf(buf, "%u", A0);
      ZXBeeAdd("A0", buf);
    }
  }
  if (strcmp(ptag, "A1") == 0) {
    if (pval[0] == '?') {
      ZXBeeAdd("A1", A1);
    }
  }
  if (strcmp(ptag, "A2") == 0) {
    if (pval[0] == '?') {
      sprintf(buf, "%u", A2);
      ZXBeeAdd("A2", buf);
    }
  }
  if (strcmp(ptag, "A3") == 0) {
    if (pval[0] == '?') {
      updateA3();
      ZXBeeAdd("A3", A3);
    }
  }
  if (strcmp(ptag, "A4") == 0) {
    if (pval[0] == '?') {
      updateA4();
      ZXBeeAdd("A4", A4);
    }
  }
  if (strcmp(ptag, "A5") == 0) {
    if (pval[0] == '?') {
      updateA5();
      ZXBeeAdd("A5", A5);
    }
  }
  
  if (strcmp(ptag, "V0") == 0) {
    if (pval[0] == '?') {
      sprintf(buf, "%u", V0);
      ZXBeeAdd("V0", buf);
    } else {
      updateV0(pval);
    }
  }
  return 0;
}
/*********************************************************************************************
* 名称：MyEventProcess()
* 功能：自定义事件处理
* 参数：event -- 事件编号
* 返回：无
* 修改：
* 注释：
*********************************************************************************************/
void MyEventProcess( uint16 event )
{
  if (event & MY_REPORT_EVT) { 
    sensorUpdate();
    //启动定时器，触发事件：MY_REPORT_EVT 
    osal_start_timerEx(simpleBLEPeripheral_TaskID, MY_REPORT_EVT, V0*1000);
  }  
  if (event & MY_CHECK_EVT) { 
    sensorCheck(); 
    // 启动定时器，触发事件：MY_CHECK_EVT 
    osal_start_timerEx(simpleBLEPeripheral_TaskID, MY_CHECK_EVT, 100);
  } 
}