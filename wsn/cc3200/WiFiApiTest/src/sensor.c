/*********************************************************************************************
* 文件：sensor.c
* 作者：Xuzhy 2018.5.16
* 说明：节点工程驱动模版
*       智能家居三种类型设备：采集类（温度采集）、安防类（人体红外报警状态）、控制类（家用电器）
*       数据包格式：{Temperature=124.0,infraredStatus=0,switchStatus=0}
*       temperature表示温度值，infraredStatus为人体红外报警状态（0/1），switchStatus为家用电器的状态（0：关闭，1：开空调，2：开加湿器，3：开空调和加湿器）
*       查询命令：查询数值参考（比如查询当前温度：{temperature=?}）
*       控制命令：cmd=0为关闭电器，cmd=1为打开空调，cmd=2为打开加湿器，cmd=3为打开空调和加湿器
* 修改：
* 注释：
*********************************************************************************************/

/*********************************************************************************************
* 头文件
*********************************************************************************************/
#include <stdio.h>
#include <string.h>
#include <stdlib.h>
#include "zxbee.h"
#include "udma_if.h"
#include "common.h"
#include "hw_ints.h"
#include "hw_types.h"
#ifndef NOTERM
#include "uart_if.h"
#endif
#include "systick_if.h"
#include "gpio.h"
#include "hw_memmap.h"
#include "pin.h"
#include "prcm.h"
#include "relay.h"
#include "math.h"
#include "sensor.h"
/*********************************************************************************************
* 宏定义
*********************************************************************************************/
#define DEBUG 1
#if DEBUG
#define DebugMsg        DBG_PRINT 
#else
#define DebugMsg(...)
#endif
/*********************************************************************************************
* 全局变量
*********************************************************************************************/
static float temperature = 0.0;                              // 温度值
/*********************************************************************************************
* 名称：sensorInit()
* 功能：传感器硬件初始化
* 参数：无
* 返回：无
* 修改：
* 注释：
*********************************************************************************************/
void sensorInit(void)
{
  DebugMsg("sensor->sensorInit(): Sensor init!\r\n"); 
  // 温度传感器初始化
  // 初始化继电器代码
  relay_init();                                                 // 继电器初始化
}
/*********************************************************************************************
* 名称：sensorLinkOn()
* 功能：传感器节点入网成功调用函数
* 参数：无
* 返回：无
* 修改：
* 注释：
*********************************************************************************************/
void sensorLinkOn(void)
{
  DebugMsg("sensor->sensorLinkOn(): Sensor Link on!\r\n"); 
  sensorUpdate();
}
/*********************************************************************************************
* 名称：sensorUpdate()
* 功能：处理主动上报的数据
* 参数：无
* 返回：无
* 修改：
* 注释：
*********************************************************************************************/
void sensorUpdate(void)
{ 
  char pData[32];
  char *p = pData;
  
  // 温度采集（0~40随机数）
  temperature = (uint16)(rand()%40);
  
  // 更新温度的值
  sprintf(p, "temperature=%.1f", temperature);
  sendMessage(p, strlen(p));
  
  DebugMsg("sensor->sensorUpdate(): temperature=%.1f\r\n", temperature);
}
/*********************************************************************************************
* 名称：sensorControl()
* 功能：传感器控制
* 参数：cmd - 控制命令
* 返回：无
* 修改：
* 注释：
*********************************************************************************************/
void sensorControl(uint8 cmd)
{
  // 根据cmd参数处理对应的控制程序
  relay_control(cmd);
}
/*********************************************************************************************
* 名称：ZXBeeInfRecv()
* 功能：节点收到无线数据包
* 参数：*pkg -- 收到的无线数据包
* 返回：
* 修改：
* 注释：
*********************************************************************************************/
void ZXBeeInfRecv(char *pkg, int len)
{
  uint8 val;
  char pData[16];
  char *p = pData;
  char *ptag = NULL;
  char *pval = NULL;

  DebugMsg("sensor->ZXBeeInfRecv(): Receive Wi-Fi Data!\r\n");
  
  ptag = pkg;
  p = strchr(pkg, '=');
  if (p != NULL) {
    *p++ = 0;
    pval = p;
  }
  val = atoi(pval);	
	
  // 控制命令解析
  if (0 == strcmp("cmd", ptag)){                                // 对D0的位进行操作，CD0表示位清零操作
    sensorControl(val);
  }
}
/*********************************************************************************************
* 名称：sensorLoop()
* 功能：定时触发功能
* 参数：无
* 返回：无
* 修改：
* 注释：
*********************************************************************************************/
void sensorLoop(void)
{
  static unsigned long ct_update = 0;
  
  if (t4exp(ct_update)) {
    sensorUpdate();
    ct_update = t4ms()+20*1000;
  }
}
