/*********************************************************************************************
* 文件：sensor.c
* 作者：Xuzhy 2018.5.16
* 说明：节点工程驱动模版
*       智慧交通系统三种类型设备：采集类（大气压力采集）、安防类（山体滑坡振动报警）、控制类（RGB交通红绿灯）
*       数据包格式：{airPressure=101.0,shockStatus=0,rgbStatus=0}
*       airPressure表示大气压力值，shockStatus为振动状态（0/1），rgbStatus为rgb灯的状态（R/G/Y）
*       查询命令：查询数值参考（比如查询当前大气压力值：{airPressure=?}）
*       控制命令：cmd=0为rgb灯灭，cmd=1为红灯，cmd=2为绿灯，cmd=3为黄灯
* 修改：
* 注释：
*********************************************************************************************/

/*********************************************************************************************
* 头文件
*********************************************************************************************/
#include <string.h>
#include <stdio.h>
#include <stdlib.h>
#include "contiki.h"
#include "stm32f10x.h"
#include "rgb.h"
#include "zxbee.h"
#include "zxbee-inf.h"
#include "sensor.h"

PROCESS(sensor, "sensor");

/*********************************************************************************************
* 全局变量
*********************************************************************************************/
static uint8_t rgbStatus = 0;                                     // RGB灯状态值
/*********************************************************************************************
* 名称：sensorInit()
* 功能：传感器硬件初始化
* 参数：无
* 返回：无
* 修改：
* 注释：
*********************************************************************************************/
void sensorInit(void)
{
  // 初始化传感器代码
  rgb_init();
}
/*********************************************************************************************
* 名称：sensorLinkOn()
* 功能：传感器节点入网成功调用函数
* 参数：无
* 返回：无
* 修改：
* 注释：
*********************************************************************************************/
void sensorLinkOn(void)
{
  sensorUpdate();
}
/*********************************************************************************************
* 名称：sensorUpdate()
* 功能：处理主动上报的数据
* 参数：无
* 返回：无
* 修改：
* 注释：
*********************************************************************************************/
void sensorUpdate(void)
{ 
  char pData[16];
  char *p = pData;
  
  ZXBeeBegin();
  
  sprintf(p, "%u", rgbStatus);                                  // 上报RGB灯状态 
  ZXBeeAdd("rgbStatus", p);
  
  p = ZXBeeEnd();                                               // 智云数据帧格式包尾
  if (p != NULL) {												
    ZXBeeInfSend(p, strlen(p));	                                // 将需要上传的数据进行打包操作，并通过zb_SendDataRequest()发送到协调器
  }
}
/*********************************************************************************************
* 名称：sensorControl()
* 功能：传感器控制
* 参数：cmd - 控制命令
* 返回：无
* 修改：
* 注释：
*********************************************************************************************/
void sensorControl(uint8_t cmd)
{
  // 根据cmd参数处理对应的控制程序
  if ((cmd & 0x01) == 0x01){                                    // RGB灯控制位：bit0~bit1
    if ((cmd & 0x02) == 0x02){                                  // cmd为3，亮黄灯
      rgb_on(0x02);                                         
      rgb_off(0x04);                                          
    }
    else{                                                       // cmd为1，亮红灯
      rgb_on(0x01);                                         
      rgb_off(0x02);                                          
      rgb_off(0x04);                                          
    }
  }
  else if ((cmd & 0x02) == 0x02){                               // cmd为2，亮绿灯
    rgb_off(0x01);                                           
    rgb_on(0x02);                                            
    rgb_off(0x04);                                           
  }
  else if (cmd == 0x0){                                         // cmd为0，灯灭
    rgb_off(0x01);                                           
    rgb_off(0x02);                                            
    rgb_off(0x04); 
  }
  rgbStatus = cmd;
}
/*********************************************************************************************
* 名称：ZXBeeUserProcess()
* 功能：解析收到的控制命令
* 参数：*ptag -- 控制命令名称
*       *pval -- 控制命令参数
* 返回：ret -- pout字符串长度
* 修改：
* 注释：
*********************************************************************************************/
int ZXBeeUserProcess(char *ptag, char *pval)
{ 
  int val;
  int ret = 0;	
  char pData[16];
  char *p = pData;
  
  // 将字符串变量pval解析转换为整型变量赋值
  val = atoi(pval);	
  // 控制命令解析
  if (0 == strcmp("cmd", ptag)){                                // RGB灯的控制命令
    sensorControl(val);
  }
  if (0 == strcmp("rgbStatus", ptag)){                        // 查询执行器命令编码
    if (0 == strcmp("?", pval)){
      ret = sprintf(p, "%u", rgbStatus);
      ZXBeeAdd("rgbStatus", p);
    } 
  }
  
  return ret;
}
/*********************************************************************************************
* 名称：sensor()
* 功能：传感器采集线程
* 参数：
* 返回：
* 修改：
* 注释：
*********************************************************************************************/
PROCESS_THREAD(sensor, ev, data)
{
  static struct etimer et_update;
  
  PROCESS_BEGIN();
  
  ZXBeeInfInit();
  
  sensorInit();
  
  etimer_set(&et_update, CLOCK_SECOND*20); 
  
  while (1) {
    PROCESS_WAIT_EVENT_UNTIL(ev == PROCESS_EVENT_TIMER); 
    if (etimer_expired(&et_update)) {
      sensorUpdate();
      etimer_set(&et_update, CLOCK_SECOND*20); 
    } 
  }
  PROCESS_END();
}